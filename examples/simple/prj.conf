## prj.conf
```kconfig
CONFIG_USB_DEVICE_STACK=y
CONFIG_USB_DEVICE_PRODUCT="Zephyr USB console sample"
CONFIG_USB_DEVICE_PID=0x0004
CONFIG_USB_DEVICE_INITIALIZE_AT_BOOT=n

# UART configuration for USB console
CONFIG_SERIAL=y
CONFIG_CONSOLE=y
CONFIG_UART_CONSOLE=y
CONFIG_UART_LINE_CTRL=y

# Enable custom device driver
CONFIG_UART_INTERRUPT_DRIVEN=y
CONFIG_BMA4XX=y

# Logging
CONFIG_LOG_DEFAULT_LEVEL=3
#CONFIG_LOG_BACKEND_UART=y
CONFIG_APP_LOG_LEVEL_DBG=y
CONFIG_BMA4XX_LOG_LEVEL_DBG=y


CONFIG_I2C=y
CONFIG_SHELL=y
CONFIG_I2C_SHELL=y
CONFIG_LOG=y
CONFIG_LOG_PRINTK=y
CONFIG_CONSOLE=y
CONFIG_UART_CONSOLE=y
CONFIG_SENSOR=y
CONFIG_SENSOR_LOG_LEVEL_DBG=y
```

## src/main.c
```c
#include <zephyr/kernel.h>
#include <zephyr/device.h>
#include <zephyr/drivers/sensor.h>
#include <zephyr/sys/printk.h>
#include <zephyr/logging/log.h>
#include <zephyr/shell/shell.h>

int main(void)
{
    return 0;
}
```
