## driver/sensors/bma400/Kconfig
```kconfig
menuconfig BMA4XX
    bool "Enable BMA4XX"
    default y
    depends on DT_HAS_BMA_4XX_ENABLED
    select I2C
    # help
	#     BMA 4XX sensor from I2C
```

## drivers/sensors/Kconfig
```kconfig
# Copyright (c) 2024 Arribada Initiative CIC
# SPDX-License-Identifier: MIT

if SENSOR
rsource "bma400/Kconfig"
endif #SENSOR
```

## west.yml
```yaml
manifest:
  defaults:
    revision: main

  remotes:
    - name: zephyr
      url-base: https://github.com/zephyrproject-rtos/
    - name: arribada
      url-base: https://github.com/arribada/

  projects:
    - name: zephyr
      remote: zephyr
      path: zephyr
      revision: v3.5.0
      import:
        name-allowlist:
          - cmsis
          - hal_nordic
          - nrf

    - name: custom-boards-zephyr
      remote: arribada
      path: modules/arribada-custom-boards
      revision: v3.6.0-add-linkit-board

  self:
    path: bma400-driver-zephyr
  
  
```
